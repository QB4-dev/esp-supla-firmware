## boards/ESP32/ESP32-TUYA-RS/brd/Kconfig.projbuild
```kconfig
menu "Board Select"
	choice
	prompt "Target board"
            default BSP_ESP32
            help
                Select target board
                
	config BSP_ESP32
	    bool "BSP_ESP32"

	endchoice
endmenu
```

## boards/ESP32/Sonoff-Mini-R4-BLE/sdkconfig.defaults
```kconfig
# CONFIG_ESPTOOLPY_FLASHSIZE_1MB is not set
# CONFIG_ESPTOOLPY_FLASHSIZE_2MB is not set
CONFIG_ESPTOOLPY_FLASHSIZE_4MB=y
# CONFIG_ESPTOOLPY_FLASHSIZE_8MB is not set
# CONFIG_ESPTOOLPY_FLASHSIZE_16MB is not set
CONFIG_ESPTOOLPY_FLASHSIZE="4MB"
CONFIG_PARTITION_TABLE_CUSTOM=y
CONFIG_PARTITION_TABLE_CUSTOM_FILENAME="partitions.csv"
CONFIG_PARTITION_TABLE_OFFSET=0x8000
CONFIG_PARTITION_TABLE_FILENAME="partitions.csv"
CONFIG_BT_ENABLED=y
CONFIG_BT_BLE_ENABLED=y
CONFIG_BT_BLUEDROID_ENABLED=y
```

## boards/ESP32/Sonoff-Mini-R4/brd/Kconfig.projbuild
```kconfig
menu "Board Select"
	choice
	prompt "Target board"
            default BSP_SONOFF_MINI_R4
            help
                Select target board
                
	config BSP_SONOFF_MINI_R4
	    bool "BSP_SONOFF-MINI-R4"

	endchoice
endmenu
```

## boards/ESP8266/ESP01-DIMMER/brd/Kconfig.projbuild
```kconfig
menu "Board Select"
	choice
	prompt "Target board"
            default BSP_ESP01_DIMMER_v1_0
            help
                Select target board
                
	config BSP_ESP01_DIMMER_v1_0
	    bool "ESP-01 DIMMER v1.0"
	    
	config BSP_ESP01_DIMMER_v1_1
	    bool "ESP-01 DIMMER v1.1"
	    
	config BSP_ESP01_DIMMER_v1_2
	    bool "ESP-01 DIMMER v1.2"

	endchoice
endmenu
```

## boards/ESP8266/ESP01-RGBW/brd/Kconfig.projbuild
```kconfig
menu "Board Select"
	choice
	prompt "Target board"
            default BSP_ESP01_RGBW_v1_0
            help
                Select target board
                
	config BSP_ESP01_RGBW_v1_0
	    bool "ESP-01 RGBW v1.0"

	endchoice
endmenu
```

## boards/ESP8266/ESP01-RGBW/sdkconfig.defaults
```kconfig
CONFIG_BSP_ESP01_RGBW_v1_0=y
CONFIG_NEWLIB_NANO_FORMAT=y
# CONFIG_ESP_LIBSUPLA_USE_ESP_TLS is not set
CONFIG_APP_UPDATE_CHECK_PROJECT_NAME=y
CONFIG_ESP_MAIN_TASK_STACK_SIZE=4096
CONFIG_ESPTOOLPY_FLASHSIZE_1MB=y
# CONFIG_ESPTOOLPY_FLASHSIZE_2MB is not set
# CONFIG_ESPTOOLPY_FLASHSIZE_4MB is not set
# CONFIG_ESPTOOLPY_FLASHSIZE_8MB is not set
# CONFIG_ESPTOOLPY_FLASHSIZE_16MB is not set
CONFIG_ESPTOOLPY_FLASHSIZE="1MB"
CONFIG_ESP8266_BOOT_COPY_APP=y
CONFIG_PARTITION_TABLE_CUSTOM=y
CONFIG_PARTITION_TABLE_CUSTOM_FILENAME="partitions.csv"
CONFIG_PARTITION_TABLE_OFFSET=0x8000
CONFIG_PARTITION_TABLE_FILENAME="partitions.csv"
# CONFIG_COMPILER_OPTIMIZATION_LEVEL_DEBUG is not set
CONFIG_COMPILER_OPTIMIZATION_LEVEL_RELEASE=y
# CONFIG_COMPILER_OPTIMIZATION_ASSERTIONS_ENABLE is not set
# CONFIG_COMPILER_OPTIMIZATION_ASSERTIONS_SILENT is not set
CONFIG_COMPILER_OPTIMIZATION_ASSERTIONS_DISABLE=y
```

## boards/ESP8266/ESP01-USB/brd/Kconfig.projbuild
```kconfig
menu "Board Select"
	choice
	prompt "Target board"
            default BSP_ESP01_USB
            help
                Select target board
                
	config BSP_ESP01_USB
	    bool "BSP_ESP01_USB"

	config BSP_ESP01_USB_DHT
	    bool "BSP_ESP01_USB_DHT"

	endchoice
endmenu
```

## boards/ESP8266/ESP12F_Relay_X4/brd/Kconfig.projbuild
```kconfig
menu "Board Select"
	choice
	prompt "Target board"
            default BSP_ESP12F_RELAY_X4_v1_2
            help
                Select target board
                
	config BSP_ESP12F_RELAY_X4_v1_2
	    bool "BSP_ESP12F_RELAY_X4_v1_2"

	endchoice
endmenu
```

## boards/ESP8266/MP46WiFi/brd/Kconfig.projbuild
```kconfig
menu "Board Select"
	choice
	prompt "Target board"
            default BSP_MP46WIFI
            help
                Select target board
                
	config BSP_MP46WIFI
	    bool "BSP_MP46WIFI"

	endchoice
endmenu
```

## boards/ESP8266/MP46WiFi/sdkconfig.defaults
```kconfig
CONFIG_BSP_MP46WIFI=y
CONFIG_ESP_LIBSUPLA_USE_ESP_TLS=y
CONFIG_APP_UPDATE_CHECK_PROJECT_NAME=y
CONFIG_ESP_MAIN_TASK_STACK_SIZE=4096
CONFIG_ESPTOOLPY_FLASHSIZE_4MB=y
CONFIG_ESPTOOLPY_FLASHSIZE="4MB"
CONFIG_ESP8266_BOOT_COPY_APP=y
CONFIG_PARTITION_TABLE_TWO_OTA=y
# CONFIG_COMPILER_OPTIMIZATION_LEVEL_DEBUG is not set
CONFIG_COMPILER_OPTIMIZATION_LEVEL_RELEASE=y
# CONFIG_COMPILER_OPTIMIZATION_ASSERTIONS_ENABLE is not set
# CONFIG_COMPILER_OPTIMIZATION_ASSERTIONS_SILENT is not set
CONFIG_COMPILER_OPTIMIZATION_ASSERTIONS_DISABLE=y
```

## boards/ESP8266/NodeMCU/brd/Kconfig.projbuild
```kconfig
menu "Board Select"
	choice
	prompt "Target board"
            default BSP_NODE_MCU
            help
                Select target board
                
	config BSP_NODE_MCU
	    bool "BSP_NODE_MCU"

	endchoice
endmenu
```

## boards/ESP8266/SONOFF-BASIC-R2/brd/Kconfig.projbuild
```kconfig
menu "Board Select"
	choice
	prompt "Target board"
            default BSP_SONOFF_BASICR2_v1_3
            help
                Select target board
	    
	config BSP_SONOFF_BASICR2_v1_3
	    bool "SONOFF BASIC R2 v1.3"
	endchoice
endmenu
```

## boards/ESP8266/SONOFF-BASIC-R2/sdkconfig.defaults
```kconfig
CONFIG_BSP_SONOFF_BASICR2_v1_3=y
CONFIG_NEWLIB_NANO_FORMAT=y
# CONFIG_ESP_LIBSUPLA_USE_ESP_TLS is not set
CONFIG_APP_UPDATE_CHECK_PROJECT_NAME=y
CONFIG_ESP_MAIN_TASK_STACK_SIZE=4096
CONFIG_ESPTOOLPY_FLASHMODE_DOUT=y
CONFIG_ESPTOOLPY_FLASHMODE="dout"
CONFIG_SPI_FLASH_MODE=0x3
CONFIG_ESPTOOLPY_FLASHFREQ_40M=y
CONFIG_ESPTOOLPY_FLASHFREQ="40m"
CONFIG_SPI_FLASH_FREQ=0x0
CONFIG_ESPTOOLPY_FLASHSIZE_1MB=y
CONFIG_ESPTOOLPY_FLASHSIZE="1MB"
CONFIG_ESP8266_BOOT_COPY_APP=y
CONFIG_PARTITION_TABLE_CUSTOM=y
CONFIG_PARTITION_TABLE_CUSTOM_FILENAME="partitions.csv"
CONFIG_PARTITION_TABLE_OFFSET=0x8000
CONFIG_PARTITION_TABLE_FILENAME="partitions.csv"
# CONFIG_COMPILER_OPTIMIZATION_LEVEL_DEBUG is not set
CONFIG_COMPILER_OPTIMIZATION_LEVEL_RELEASE=y
# CONFIG_COMPILER_OPTIMIZATION_ASSERTIONS_ENABLE is not set
# CONFIG_COMPILER_OPTIMIZATION_ASSERTIONS_SILENT is not set
CONFIG_COMPILER_OPTIMIZATION_ASSERTIONS_DISABLE=y
```

## main/Kconfig.projbuild
```kconfig
menu "Board Select"
	choice BOARD
	prompt "Target board"
            default BSP_ESP01_DIMMER_v1_0
            help
                Select target board
                
	config BSP_ESP01_DIMMER_v1_0
	    bool "ESP-01 DIMMER v1.0"
	    
	config BSP_ESP01_DIMMER_v1_1
	    bool "ESP-01 DIMMER v1.1"
	    
	config BSP_ESP01_RGBW
	    bool "ESP-01 RGBW"

	config BSP_ESP01_PLUG_DHT
	    bool "ESP-01 PLUG DHT"

	endchoice
endmenu
```
